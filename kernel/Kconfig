## kernel/Kconfig
```kconfig
menu "KernelSU"

config KSU
		bool "KernelSU function support"
		depends on EXT4_FS
		default y
		help
			Manual (built-in) LSM hooks are the only supported mode.
			Requires CONFIG_EXT4_FS for `ext4_unregister_sysfs`.
			Built-in mode only.

config KSU_DEBUG
		bool "KernelSU debug mode"
		depends on KSU
		default n
		help
			Enable KernelSU debug mode.

endmenu
```
